## config/west.yml
```yaml
# Copyright (c) 2025 The ZMK Contributors
# SPDX-License-Identifier: LicenseRef-Nordic-5-Clause

manifest:
  remotes:
    - name: zmkfirmware
      url-base: https://github.com/zmkfirmware
  projects:
    - name: zmk
      remote: zmkfirmware
      revision: v0.3
      import: app/west.yml
  self:
    path: config
```

## src/behaviors/Kconfig
```kconfig
# Copyright (c) 2025 The ZMK Contributors
# SPDX-License-Identifier: LicenseRef-Nordic-5-Clause

config ZMK_BEHAVIOR_CAPS_WORD_CUSTOM
    bool "Custom Caps Word Behavior"
    default y
```
